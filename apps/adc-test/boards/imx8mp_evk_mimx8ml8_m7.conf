## apps/adc-test/dts/bindings/ti,ads8688.yaml
```yaml
description: TI ADS8688 8ch 16bit SAR ADC (raw SPI — Zephyr ドライバ無し。app が spi_dt_spec で直接叩く)
compatible: "ti,ads8688"
include: spi-device.yaml
```

## apps/west.yml
```yaml
manifest:
  remotes:
    - name: zephyrproject-rtos
      url-base: https://github.com/zephyrproject-rtos

  projects:
    - name: zephyr
      remote: zephyrproject-rtos
      revision: v4.3.0
      import:
        # 全モジュール (数 GB) は引かず、i.MX8MM M4 ビルドに要るものだけ
        name-allowlist:
          - cmsis_6
          - hal_nxp

  self:
    path: apps
```
